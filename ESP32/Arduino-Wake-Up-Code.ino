#include <WiFi.h>
#include <Firebase_ESP_Client.h>
#include "time.h"

// Replace with your Wi-Fi credentials
#define WIFI_SSID "Iphone"
#define WIFI_PASSWORD "iphone1234"

// Replace with your Firebase credentials
#define FIREBASE_HOST "wake-up-44e5a-default-rtdb.europe-west1.firebasedatabase.app"
#define FIREBASE_AUTH "jo77EvojCDOYz1ZS23rDX29b6WPFvPLVCtG0juAA"


// Pin where your force sensor is connected
#define FORCE_SENSOR_PIN 34 // GPIO2 on ESP32
// pressure threshold : which defines whether there is pressure or not 
#define PRESSURE_THRESHOLD 300
#define motor_pin 33
String currentUserId = "";

int lastState = 0;
unsigned long startTime = 0;
bool sessionActive = false;

static int sessionCounter = 1; // This counter resets on each reboot unless stored persistently


// Firebase objects
FirebaseData fbdo;
FirebaseAuth auth;
FirebaseConfig config;

void setup() {
  Serial.begin(115200);
  delay(200);  
Serial.println(">>> SERIAL OK @ 115200 <<<");

pinMode(motor_pin, OUTPUT);
digitalWrite(motor_pin, LOW);  // ensure it s off at boot


  // Connect to Wi-Fi
  WiFi.begin(WIFI_SSID, WIFI_PASSWORD);
  Serial.print("Connecting to WiFi");
  while (WiFi.status() != WL_CONNECTED) {
    delay(500);
#include <WiFi.h>
#include <Firebase_ESP_Client.h>
#include "time.h"

// Replace with your Wi-Fi credentials
#define WIFI_SSID "Iphone"
#define WIFI_PASSWORD "iphone1234"

// Replace with your Firebase credentials
#define FIREBASE_HOST "wake-up-44e5a-default-rtdb.europe-west1.firebasedatabase.app"
#define FIREBASE_AUTH "jo77EvojCDOYz1ZS23rDX29b6WPFvPLVCtG0juAA"


// Pin where your force sensor is connected
#define FORCE_SENSOR_PIN 34 // GPIO2 on ESP32
// pressure threshold : which defines whether there is pressure or not 
#define PRESSURE_THRESHOLD 300
#define motor_pin 33
String currentUserId = "";

int lastState = 0;
unsigned long startTime = 0;
bool sessionActive = false;

static int sessionCounter = 1; // This counter resets on each reboot unless stored persistently


// Firebase objects
FirebaseData fbdo;
FirebaseAuth auth;
FirebaseConfig config;

void setup() {
  Serial.begin(115200);
  delay(200);  
Serial.println(">>> SERIAL OK @ 115200 <<<");

pinMode(motor_pin, OUTPUT);
digitalWrite(motor_pin, LOW);  // ensure it s off at boot


  // Connect to Wi-Fi
  WiFi.begin(WIFI_SSID, WIFI_PASSWORD);
  Serial.print("Connecting to WiFi");
  while (WiFi.status() != WL_CONNECTED) {
    delay(500);
   Serial.print(".");
  }
  Serial.println("\nConnected to WiFi");

  //FireBase api_key 
config.api_key="AIzaSyBKlQDZVB4MD8tzgsFz5wP8hpUav0kUa5w";

  // Firebase config
  config.database_url = FIREBASE_HOST;
  config.signer.tokens.legacy_token = FIREBASE_AUTH;

  Firebase.begin(&config, &auth);
  Firebase.reconnectWiFi(true);

  // Optional: Set ADC range
  analogSetAttenuation(ADC_11db);


  Serial.begin(115200);
  //   connect Wi-Fi and Firebase as before  

  configTime(0, 0, "pool.ntp.org"); // For getting time via NTP
}


void loop() {
  

   // 1) Read the user-ID node from your DB
  //    Suppose you ve stored it at "/currentUserId"
  if (Firebase.RTDB.getString(&fbdo, "/current-user")) {
    currentUserId = fbdo.stringData();
    Serial.println("Loaded user ID: " + currentUserId);
  } else {
    Serial.print("DB read failed: ");
    Serial.println(fbdo.errorReason());
  }
  
  int forceValue = analogRead(FORCE_SENSOR_PIN);
  Serial.print("Force sensor reading: ");
  Serial.println(forceValue);

  // Send 1 or 0 to /hardware/pressure
  int pressureFlag = (forceValue > PRESSURE_THRESHOLD) ? 1 : 0;
  if (Firebase.RTDB.setInt(&fbdo, "/users/"+currentUserId+"/hardware/pressure", pressureFlag)) {
    Serial.print("? user/hardware/pressure = ");
    Serial.println(pressureFlag);
  } else {
    Serial.print("Firebase Error: ");
    Serial.println(fbdo.errorReason());
  }


if (pressureFlag != lastState) {
  if (pressureFlag == 1) {
    // Pressure applied, session starts
    startTime = time(nullptr); // Get current time
    Serial.println("Pressure detected. Session started.");
    sessionActive = true;
  }
  else if (pressureFlag == 0 && sessionActive) {
    // Pressure released, session ends
    unsigned long endTime = time(nullptr);
    unsigned long duration = (endTime - startTime) / 60; // Duration in minutes

    Serial.print("Session ended. Duration: ");
    Serial.print(duration);
    Serial.println(" minutes");

    // Generate session key like s1, s2, ...
    String sessionKey = "s" + String(sessionCounter);
    String path2 = "users/" + currentUserId + "/sessions/" + sessionKey;

    // Upload to Firebase
    if (Firebase.RTDB.setInt(&fbdo, path2, duration)) {
      Serial.println("✅ Session saved to Firebase at " + path2);
      sessionCounter++; // Increment only after successful save
    } else {
      Serial.println("❌ Failed to save session: " + fbdo.errorReason());
    }

    sessionActive = false;
  }

  lastState = pressureFlag;
}


  // --- 2) Motor control ---  
  String path = "/users/"+currentUserId+"/hardware/motor";
  if (Firebase.RTDB.getInt(&fbdo, path)) {
    int motorFlag = fbdo.intData();         // should be 0 or 1
    digitalWrite(motor_pin, motorFlag ? LOW : HIGH);
    Serial.printf("Motor=%d → GPIO33 is %s\n",
                  motorFlag,

                  motorFlag ? "ON" : "OFF");
  } else {
    Serial.print("Error reading motor path: ");
    Serial.println(fbdo.errorReason());
  }


  delay(500); // Send data every 0.5 second
}

